## samples/nrf9160/customized/coap_node/Kconfig
```kconfig
#
# Copyright (c) 2019 Nordic Semiconductor ASA
#
# SPDX-License-Identifier: LicenseRef-BSD-5-Clause-Nordic
#

menu "nRF CoAP client sample"

config COAP_RESOURCE
	string "CoAP resource - defaults to Californium observable resource"
	default "obs"

config COAP_SERVER_HOSTNAME
	string "CoAP server hostname"
	default "storo.nntb.no"

config COAP_SERVER_PORT
	int "CoAP server port"
	default 5683

config TEST_SEND_INTERVAL_MS 
	int "Time in between packet bursts in milliseconds"
	default 60000

config TEST_PCK_ITT_MS
	int "Packet intertransmisson time in milliseconds"
	default 5000

config TEST_PCK_NR_IN_BURST  
	int "Number of packets in a burst"
	default 1

config TEST_MAX_MSG_LEN_BYTE
	int "CoAP packet payload length in bytes"
	default 10

config TEST_DURATION
	int "Test duration in minutes"
	default 60

config TEST_COAP_TYPE
   int "CoAP message type, COAP_TYPE_CON: 0, COAP_TYPE_NON_CON: 1,"
   default 1

config TEST_COAP_METHOD 
	int "CoAP method, 	COAP_METHOD_GET: 1, COAP_METHOD_POST: 2, COAP_METHOD_PUT: 3, COAP_METHOD_DELETE: 4"
	default 1

endmenu

menu "Zephyr Kernel"
source "$ZEPHYR_BASE/Kconfig.zephyr"
endmenu
```

## samples/nrf9160/customized/mqtt_node/Kconfig
```kconfig
#
# Copyright (c) 2018 Nordic Semiconductor ASA
#
# SPDX-License-Identifier: LicenseRef-BSD-5-Clause-Nordic
#

menu "MQTT simple sample"
config MQTT_PUB_TOPIC
	string "MQTT publish topic"
	default "test"

config MQTT_SUB_TOPIC
	string "MQTT subscribe topic"
	default "test"

config MQTT_CLIENT_ID
	string "MQTT Client ID"
	default "my-client-id"

config MQTT_BROKER_HOSTNAME
	string "MQTT broker hostname"
	default "storo.nntb.no"

config MQTT_BROKER_PORT
	int "MQTT broker port"
	default 1883

config TEST_SEND_INTERVAL_MS 
	int "Time in between packet bursts in milliseconds"
	default 60000

config TEST_PCK_ITT_MS
	int "Packet intertransmisson time in milliseconds"
	default 5000

config TEST_PCK_NR_IN_BURST  
	int "Number of packets in a burst"
	default 1

config TEST_MAX_MSG_LEN_BYTE
	int "CoAP packet payload length in bytes"
	default 10

config TEST_DURATION
	int "Test duration in minutes"
	default 60

config TEST_MQTT_QOS 
	int "MQTT QoS type, MQTT_QOS_0_AT_MOST_ONCE: 0x00, MQTT_QOS_1_AT_LEAST_ONCE: 0x01, MQTT_QOS_2_EXACTLY_ONCE: 0x02"
	default 0
endmenu

menu "Zephyr Kernel"
source "$ZEPHYR_BASE/Kconfig.zephyr"
endmenu
```
